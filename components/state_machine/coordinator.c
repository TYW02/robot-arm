/* Stage 1: receive observations only. No Motion API is used here. */
#include <tk/tkernel.h>
#include <tm/tmonitor.h>
#include "coordinator.h"
#include "../vision_pico/vision_task.h"

static const char *colour_name(VisionColour colour)
{
    switch (colour) {
    case VISION_RED: return "RED";
    case VISION_GREEN: return "GREEN";
    case VISION_BLUE: return "BLUE";
    default: return "NONE";
    }
}

static void coordinator_task(INT start_code, void *extended_info)
{
    (void)start_code;
    (void)extended_info;

    /* Colour mode makes the first hardware test deterministic: the camera
     * sends both detections and explicit NO_OBJECT. Keep the existing retry. */
    ER error = VisionSetMode(VISION_MODE_COLOUR);
    if (error < E_OK) goto fault;
    tk_dly_tsk(50);
    error = VisionSetMode(VISION_MODE_COLOUR);
    if (error < E_OK) goto fault;

    while (1) {
        VisionResult result;
        error = VisionReceive(&result, 2000);
        if (error == E_TMOUT) {
            tm_printf((UB *)"[coordinator] VISION_TIMEOUT (not NO_OBJECT)\n");
            continue;
        }
        if (error < E_OK) goto fault;
        switch (result.status) {
        case VISION_OK:
            if (result.kind == VISION_COLOUR) {
                tm_printf((UB *)"[coordinator] VISION_OK colour=%s x_px=%d y_px=%d\n",
                          colour_name(result.colour), result.x_px, result.y_px);
            } else if (result.kind == VISION_ARUCO) {
                /* This port's tm_printf has no float formatting. The typed
                 * result still retains width_px and distance_mm as floats. */
                tm_printf((UB *)"[coordinator] VISION_OK marker_id=%d x_px=%d y_px=%d\n",
                          (INT)result.marker_id, result.x_px, result.y_px);
            }
            break;
        case VISION_NO_OBJECT:
            tm_printf((UB *)"[coordinator] VISION_NO_OBJECT\n");
            break;
        case VISION_INVALID_PACKET:
            tm_printf((UB *)"[coordinator] VISION_INVALID_PACKET\n");
            break;
        case VISION_TIMEOUT:
            break; /* Generated by VisionReceive on E_TMOUT, handled above. */
        }
        /* MOVE_TO_PAYLOAD / EXECUTE_PICK are intentionally absent here.
         * Pixel -> workspace -> ArmPose conversion is not validated. */
    }
fault:
    tm_printf((UB *)"[coordinator] vision IPC fault: %d\n", error);
    tk_slp_tsk(TMO_FEVR);
}

static T_CTSK coordinator_definition = {
    .itskpri = 10, .stksz = 4096, .task = coordinator_task,
#if TK_SUPPORT_SMP
    /* Processor 2 = physical core 1; UART IRQ/device ownership stays on 0. */
    .tskatr = TA_HLNG | TA_RNG3 | TA_ASSPRC, .assprc = TP_PRC2
#else
    .tskatr = TA_HLNG | TA_RNG3
#endif
};

ER CoordinatorStart(void)
{
    ID coordinator = tk_cre_tsk(&coordinator_definition);
    if (coordinator < E_OK) return coordinator;
    ER error = tk_sta_tsk(coordinator, 0);
    if (error < E_OK) tk_del_tsk(coordinator);
    return error;
}
